#include "oled_chinese.h"

#define CN_GLYPH_COUNT 21U
static const uint8_t glyph_bytes[CN_GLYPH_COUNT][OLED_CHINESE_GLYPH_BYTES] = {
    { 0x00U, 0x00U, 0x01U, 0x00U, 0x11U, 0x00U, 0x11U, 0xF8U, 0x11U, 0x00U, 0x11U, 0x00U, 0x7FU, 0xFCU, 0x01U, 0x00U, 0x09U, 0x00U, 0x11U, 0x10U, 0x21U, 0x20U, 0x01U, 0x40U, 0x01U, 0x00U, 0x0CU, 0x00U, 0x60U, 0x00U, 0x00U, 0x00U },
    { 0x00U, 0x00U, 0x08U, 0x20U, 0x2AU, 0x20U, 0x08U, 0x00U, 0x7FU, 0x7EU, 0x1CU, 0x44U, 0x28U, 0x00U, 0x00U, 0x80U, 0x00U, 0x08U, 0x7EU, 0x00U, 0x02U, 0x10U, 0x20U, 0x10U, 0x0CU, 0x28U, 0x0AU, 0x44U, 0x20U, 0x82U, 0x00U, 0x00U },
    { 0x00U, 0x20U, 0x08U, 0x20U, 0x08U, 0x20U, 0x08U, 0x24U, 0x7EU, 0x20U, 0x08U, 0x22U, 0x18U, 0x20U, 0x08U, 0x20U, 0x28U, 0x24U, 0x08U, 0x20U, 0x48U, 0x08U, 0x08U, 0x10U, 0x08U, 0x00U, 0x09U, 0x00U, 0x00U, 0x00U, 0x00U, 0x00U },
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    { 0x00U,0x00U,0x00U,0x7CU,0x7FU,0xC0U,0x01U,0x00U,0x01U,0x00U,0x3FU,0xF8U,0x21U,0x08U,0x21U,0x08U,0x21U,0x08U,0x21U,0x08U,0x21U,0x08U,0x21U,0x08U,0x21U,0x38U,0x01U,0x00U,0x01U,0x00U,0x00U,0x00U }
};


static const uint8_t text_step[] = { 0, 1 };
static const uint8_t text_stopwatch[] = { 2, 3 };

static const uint8_t text_level[] = { 4, 5, 6 };
static const uint8_t text_flashlight[] = { 7, 8, 9 };

static const uint8_t text_battery[] = { 8, 12 };






static const uint8_t text_score[] = { 13, 14 };

static const uint8_t text_game_over[] = { 10, 11, 15, 16 };



static const uint8_t text_battery_level[] = { 8, 17 };


static const uint8_t text_coin[] = { 18, 19, 20 };

typedef struct { const uint8_t *glyphs; uint8_t count; } ChineseTextDef;

static const ChineseTextDef chinese_texts[OLED_TEXT_COUNT] = {
    { text_step, 2U },
    { text_stopwatch, 2U },
    { text_level, 3U },
    { text_flashlight, 3U },
    { text_battery, 2U },
    { text_score, 2U },
    { text_game_over, 4U },
    { text_battery_level, 2U },
    { text_coin, 3U }
};

uint8_t OLED_Chinese_TextWidth(OledChineseTextId text)
{
    if (text >= OLED_TEXT_COUNT)
        return 0U;

    return (uint8_t)(chinese_texts[text].count * OLED_CHINESE_FONT_WIDTH);
}

uint8_t OLED_Chinese_TextWidthSmall(OledChineseTextId text)
{
    return text < OLED_TEXT_COUNT ? (uint8_t)(chinese_texts[text].count * 8U) : 0U;
}

void OLED_Chinese_DrawTextSmall(uint8_t x, uint8_t y,
                                OledChineseTextId text, SSD1306_COLOR color)
{
    if (text >= OLED_TEXT_COUNT) return;
    for (uint8_t c = 0; c < chinese_texts[text].count; c++)
    {
        const uint8_t *glyph = glyph_bytes[chinese_texts[text].glyphs[c]];
        for (uint8_t row = 0; row < 8U; row++)
            for (uint8_t col = 0; col < 8U; col++)
            {
                uint8_t sx = (uint8_t)(col * 2U), sy = (uint8_t)(row * 2U);
                if ((glyph[sy * 2U + sx / 8U] & (uint8_t)(0x80U >> (sx % 8U))) != 0U)
                    ssd1306_DrawPixel((uint8_t)(x + c * 8U + col), (uint8_t)(y + row), color);
            }
    }
}

void OLED_Chinese_DrawText(uint8_t x, uint8_t y,
                           OledChineseTextId text,
                           SSD1306_COLOR color)
{
    const ChineseTextDef *definition;

    if (text >= OLED_TEXT_COUNT)
        return;

    definition = &chinese_texts[text];

    for (uint8_t character = 0; character < definition->count; character++)
    {
        const uint8_t *glyph = glyph_bytes[definition->glyphs[character]];

        for (uint8_t row = 0; row < OLED_CHINESE_FONT_HEIGHT; row++)
        {
            for (uint8_t column = 0; column < OLED_CHINESE_FONT_WIDTH; column++)
            {
                uint16_t pixel_x = (uint16_t)x + character * OLED_CHINESE_FONT_WIDTH + column;
                uint16_t pixel_y = (uint16_t)y + row;
                uint8_t byte = glyph[row * 2U + column / 8U];
                uint8_t mask = (uint8_t)(0x80U >> (column % 8U));

                if ((byte & mask) != 0U &&
                    pixel_x < SSD1306_WIDTH && pixel_y < SSD1306_HEIGHT)
                {
                    ssd1306_DrawPixel((uint8_t)pixel_x, (uint8_t)pixel_y, color);
                }
            }
        }
    }
}
